## firmware/esp32/sdkconfig.defaults
```kconfig
#============================================================================
# sdkconfig.defaults
# Default SDK Configuration for SAR Radar ESP32-C3 WiFi Bridge
#
# These defaults are applied when running `idf.py set-target esp32c3`
# for the first time. They can be overridden via `idf.py menuconfig`.
#
# Key design decisions:
#   - ESP32-C3 RISC-V single core, 160 MHz
#   - WiFi AP mode with 40 MHz channel width for max throughput
#   - SPI slave mode for FPGA communication
#   - BLE enabled for configuration interface
#   - 4MB flash with OTA dual-partition layout
#   - Log level INFO (change to DEBUG for development)
#
# Author: SAR Radar Project
# Date:   2026-02-21
#============================================================================

#--------------------------------------------------------------------
# Target: ESP32-C3
#--------------------------------------------------------------------
CONFIG_IDF_TARGET="esp32c3"

#--------------------------------------------------------------------
# CPU & Memory
#--------------------------------------------------------------------
# ESP32-C3 runs at 160 MHz (max for RISC-V core)
CONFIG_ESP_DEFAULT_CPU_FREQ_MHZ_160=y
CONFIG_ESP_DEFAULT_CPU_FREQ_MHZ=160

#--------------------------------------------------------------------
# Flash Configuration
#--------------------------------------------------------------------
# 4MB flash, QIO mode for maximum throughput
CONFIG_ESPTOOLPY_FLASHSIZE_4MB=y
CONFIG_ESPTOOLPY_FLASHSIZE="4MB"
CONFIG_ESPTOOLPY_FLASHMODE_QIO=y
CONFIG_ESPTOOLPY_FLASHFREQ_80M=y

#--------------------------------------------------------------------
# Partition Table
#--------------------------------------------------------------------
# Use custom partition table for OTA support
# Factory (1MB) + OTA_0 (1.5MB) + OTA_1 (1.5MB) = 4MB
CONFIG_PARTITION_TABLE_CUSTOM=y
CONFIG_PARTITION_TABLE_CUSTOM_FILENAME="partitions.csv"
CONFIG_PARTITION_TABLE_FILENAME="partitions.csv"

#--------------------------------------------------------------------
# WiFi Configuration
#--------------------------------------------------------------------
# SoftAP mode, 802.11n with 40 MHz channel for max throughput
CONFIG_ESP_WIFI_SOFTAP_SUPPORT=y
CONFIG_ESP_WIFI_NVS_ENABLED=y
CONFIG_ESP_WIFI_AMPDU_TX_ENABLED=y
CONFIG_ESP_WIFI_AMPDU_RX_ENABLED=y
CONFIG_ESP_WIFI_TX_BA_WIN=6
CONFIG_ESP_WIFI_RX_BA_WIN=6

# Static TX buffer for better performance
CONFIG_ESP_WIFI_STATIC_TX_BUFFER=y
CONFIG_ESP_WIFI_TX_BUFFER_TYPE=0
CONFIG_ESP_WIFI_STATIC_TX_BUFFER_NUM=8
CONFIG_ESP_WIFI_DYNAMIC_RX_BUFFER_NUM=16
CONFIG_ESP_WIFI_STATIC_RX_BUFFER_NUM=4

# WiFi task configuration
CONFIG_ESP_WIFI_TASK_PINNED_TO_CORE_0=y

# Max WiFi TX power
CONFIG_ESP_PHY_MAX_WIFI_TX_POWER=20

#--------------------------------------------------------------------
# Bluetooth (BLE) Configuration
#--------------------------------------------------------------------
# Enable BLE for configuration interface
CONFIG_BT_ENABLED=y
CONFIG_BT_NIMBLE_ENABLED=y
CONFIG_BT_NIMBLE_MAX_CONNECTIONS=1
CONFIG_BT_NIMBLE_ROLE_PERIPHERAL=y
CONFIG_BT_NIMBLE_ROLE_CENTRAL=n
CONFIG_BT_NIMBLE_ROLE_OBSERVER=n
CONFIG_BT_NIMBLE_ROLE_BROADCASTER=y

# Use NimBLE (lighter weight than Bluedroid for BLE-only)
CONFIG_BT_CONTROLLER_ENABLED=y

#--------------------------------------------------------------------
# SPI Configuration
#--------------------------------------------------------------------
# SPI slave mode for FPGA communication
# DMA enabled for efficient transfers
CONFIG_SPI_SLAVE_ISR_IN_IRAM=y

#--------------------------------------------------------------------
# LWIP (TCP/IP Stack) Configuration
#--------------------------------------------------------------------
# Optimize for streaming throughput
CONFIG_LWIP_TCP_MSS=1436
CONFIG_LWIP_TCP_SND_BUF_DEFAULT=16384
CONFIG_LWIP_TCP_WND_DEFAULT=16384
CONFIG_LWIP_TCP_RECVMBOX_SIZE=12
CONFIG_LWIP_UDP_RECVMBOX_SIZE=12
CONFIG_LWIP_TCPIP_RECVMBOX_SIZE=32
CONFIG_LWIP_TCP_QUEUE_OOSEQ=y

# Disable IPv6 (not needed for local streaming)
CONFIG_LWIP_IPV6=n

# Socket options
CONFIG_LWIP_MAX_SOCKETS=8
CONFIG_LWIP_SO_REUSE=y

#--------------------------------------------------------------------
# FreeRTOS Configuration
#--------------------------------------------------------------------
CONFIG_FREERTOS_HZ=1000
CONFIG_FREERTOS_TIMER_TASK_STACK_DEPTH=2048
CONFIG_FREERTOS_IDLE_TASK_STACKSIZE=1024
CONFIG_FREERTOS_ISR_STACKSIZE=1536

# Enable task watchdog
CONFIG_ESP_TASK_WDT_EN=y
CONFIG_ESP_TASK_WDT_TIMEOUT_S=30
CONFIG_ESP_TASK_WDT_CHECK_IDLE_TASK_CPU0=y

#--------------------------------------------------------------------
# OTA Configuration
#--------------------------------------------------------------------
CONFIG_BOOTLOADER_APP_ROLLBACK_ENABLE=y

#--------------------------------------------------------------------
# Logging
#--------------------------------------------------------------------
# INFO level for production; change to DEBUG during development
CONFIG_LOG_DEFAULT_LEVEL_INFO=y
CONFIG_LOG_DEFAULT_LEVEL=3
CONFIG_LOG_MAXIMUM_LEVEL_DEBUG=y
CONFIG_LOG_MAXIMUM_LEVEL=4

# Colored log output
CONFIG_LOG_COLORS=y

#--------------------------------------------------------------------
# System
#--------------------------------------------------------------------
# Main task stack size (needs to be larger for init)
CONFIG_ESP_MAIN_TASK_STACK_SIZE=4096

# Enable heap tracing for debugging memory issues
CONFIG_HEAP_POISONING_DISABLED=y
CONFIG_HEAP_TRACING_OFF=y

# Watchdog timer
CONFIG_ESP_INT_WDT_TIMEOUT_MS=300

#--------------------------------------------------------------------
# Power Management
#--------------------------------------------------------------------
# Disable power management for consistent performance
# (handheld device will have its own power management)
CONFIG_PM_ENABLE=n

#--------------------------------------------------------------------
# Performance Optimizations
#--------------------------------------------------------------------
# Place hot functions in IRAM for faster execution
CONFIG_SPI_MASTER_ISR_IN_IRAM=y
CONFIG_COMPILER_OPTIMIZATION_PERF=y
```
